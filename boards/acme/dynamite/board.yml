## west.yml
```yaml
# The west manifest file for Bridle for embedded systems based on Zephyr.
#
# Copyright (c) 2021-2023 TiaC Systems
# Copyright (c) 2019-2021 Li-Pro.Net
#
# SPDX-License-Identifier: Apache-2.0
#
# The per-installation west configuration file, .west/config, sets the
# path to the project containing this file in the [manifest] section's
# "path" variable.
#
# You are free to create your own manifest files and put them in any
# repository you want, to create your own custom Zephyr installations.
# For example, you could create a manifest file in your own out of
# tree application directory, which would pull this Zephyr repository
# in as an ordinary project.
#
# You can pass your manifest repositories to west init when creating a
# new Zephyr installation. See the west documentation for more
# information.

manifest:
  version: "0.13"

  # If not otherwise specified, the projects below should be obtained
  # from the tiacsys remote.
  defaults:
    remote: tiacsys

  # "remotes" is a list of locations where git repositories are cloned
  # and fetched from.
  remotes:
    - name: tiacsys
      url-base: https://github.com/tiacsys

  # West-related configuration for the Bridle repository.
  self:
    # This repository should be cloned to workspace/bridle.
    path: bridle-dojo
    # This line configures west extensions which are currently
    # only for internal use by TIAC maintainers; import build
    # commands from Zephyr repo.

  projects:

    - name: bridle
      path: bridle
      repo-path: bridle
      revision: v4.3-branch

      import: 
        name-blocklist:
          - ubxlib
          - zephyr
          - cannectivity
      
      userdata:
        west-commands-path: scripts/west_commands
    



    - name: zephyr
      path: zephyr
      remote: tiacsys
      repo-path: zephyr
      revision: tiacsys/v4.3-branch
      clone-depth: 5000
      # import submodules from Zephyr manifest
      import:
        # In addition to the Zephyr repository itself, TIAC also
        # imports the contents of Zephyr/west.yml at the above
        # revision. Only the projects explicitly named in the
        # following allowlist are imported.
        #
        # Note that the Zephyr west extensions (like 'build', 'flash',
        # 'debug', etc.) are automatically provided by this import, so
        # there's no need to add a redundant west-commands: key for
        # the Zephyr project.
        #
        # Please keep this list sorted alphabetically.
        name-allowlist:
          - cmsis
          - cmsis_6
          - hal_rpi_pico
          - lvgl
           # hook up for Bridle zephyr_trampoline.py
      userdata:
        west-commands-path: scripts/west_commands

    # The original CANnectivity project as application folder. Hold the
    # revision in sync with the right Zephyr version:
    #
    #     CANnectivity    Zephyr RTOS
    #     ============    ===========
    #     main            main
    #     v1.3-branch     v4.3-branch
    #     v1.3.0          v4.3-branch
    #     v1.2-branch     v4.2-branch
    #     v1.2.1          v4.2-branch
    #     v1.2.0          v4.2-branch
    #     v1.1-branch     v4.1-branch
    #     v1.1.0          v4.1-branch
    #     v1.0-branch     v4.0-branch
    #     v1.0.2          v4.0-branch
    #     v1.0.1          v4.0-branch
    #     v1.0.0          v4.0-branch
    #
    - name: cannectivity
      path: cannectivity
      remote: tiacsys
      repo-path: cannectivity
      revision: tiacsys/v1.3-branch
      clone-depth: 5000
      # import submodules from CANnectivity manifest
      import:
        # In addition to the CANnectivity repository itself, TIAC also
        # imports the contents of cannectivity/west.yml at the above
        # revision. Only the projects explicitly named in the
        # following allowlist are imported.
        #
        # Please keep this list sorted alphabetically.
        # zephyr-keep-sorted-start re(^\s+\- \w)
        name-allowlist:
          []
          # zephyr-keep-sorted-stop
        #
        # Zephyr as defined by CANnectivity will be blocked, TIAC has
        # its own definition in the submanifests/zephyr.yml file.
        #
        # Please keep this list sorted alphabetically.
        # zephyr-keep-sorted-start re(^\s+\- \w)
        name-blocklist:
          - zephyr
          # zephyr-keep-sorted-stop
```
